## main/Kconfig.projbuild
```kconfig
menu "PC Monitor"

    comment "Display is the onboard CO5300 on ESP32-S3-Touch-AMOLED-1.75C."
    comment "Resolution 466 x 466, QSPI. Pins come from the Waveshare BSP."

endmenu
```
